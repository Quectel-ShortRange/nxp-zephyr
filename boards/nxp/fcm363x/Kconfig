## boards/nxp/fcm363x/Kconfig
```kconfig
# Copyright 2025 NXP
# SPDX-License-Identifier: Apache-2.0

config BOARD_FCM363X
	bool "Enable FCM363X board support"
	select BOARD_EARLY_INIT_HOOK
```

## boards/nxp/fcm363x/Kconfig.fcm363x
```kconfig
# Copyright 2024 NXP
# SPDX-License-Identifier: Apache-2.0

config BOARD_FCM363X
	select SOC_PART_NUMBER_RW610UKA2I
```

## boards/nxp/fcm363x/board.yml
```yaml
board:
  name: fcm363x
  full_name: FCM363X
  vendor: nxp
  socs:
    - name: rw612
      variants:
        - name: ns
```

## boards/nxp/fcm365x/Kconfig
```kconfig
# Copyright 2025 NXP
# SPDX-License-Identifier: Apache-2.0

config BOARD_FCM365X
	bool "Enable FCM365X board support"
	select BOARD_EARLY_INIT_HOOK
```

## boards/nxp/fcm365x/Kconfig.fcm365x
```kconfig
# Copyright 2024 NXP
# SPDX-License-Identifier: Apache-2.0

config BOARD_FCM365X
	select SOC_PART_NUMBER_RW612UKA2I
	# default "RW612ETA2I" if SOC_PART_NUMBER_RW612ETA2I
	# default "RW612HNA2I" if SOC_PART_NUMBER_RW612HNA2I
	# default "RW612UKA2I" if SOC_PART_NUMBER_RW612UKA2I
```

## boards/nxp/fcm365x/board.yml
```yaml
board:
  name: fcm365x
  full_name: FCM365X
  vendor: nxp
  socs:
    - name: rw612
      variants:
        - name: ns
```
